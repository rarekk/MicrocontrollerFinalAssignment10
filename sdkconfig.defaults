## sdkconfig.defaults
```kconfig
# Serial Console
CONFIG_LOG_DEFAULT_LEVEL_INFO=y
CONFIG_LOG_COLORS=y

# FreeRTOS
CONFIG_FREERTOS_HZ=1000
CONFIG_FREERTOS_USE_TRACE_FACILITY=y

# Wi-Fi
CONFIG_ESP_WIFI_ENABLED=y
CONFIG_ESP_WIFI_MODE_STA=y
CONFIG_ESP_WIFI_SOFTAP_SUPPORT=n

# SNTP
CONFIG_LWIP_SNTP_MAX_SERVERS=1
CONFIG_LWIP_DHCP_GET_NTP_SRV=y
CONFIG_LWIP_SNTP_UPDATE_DELAY=3600000

# I2C
CONFIG_I2C_MASTER_ENABLED=y

# C++ Exceptions
CONFIG_COMPILER_CXX_RTTI=y
CONFIG_COMPILER_CXX_EXCEPTIONS=n
CONFIG_GCOV_ENABLED=n

# Flash
CONFIG_PARTITION_TABLE_CUSTOM=y
CONFIG_PARTITION_TABLE_CUSTOM_FILENAME="partitions.csv"
CONFIG_PARTITION_TABLE_OFFSET=0x8000
```
