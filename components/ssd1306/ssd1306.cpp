// SSD1306.cpp - OLED Display Driver (128x64 I2C)
#include "ssd1306/SSD1306.hpp"
#include <cstring>
#include <cmath>

// Simple 7x5 Font bitmap for VT323/Monospace style rendering
static const uint8_t font5x7[95][5] = {
    {0x00,0x00,0x00,0x00,0x00}, // space
    {0x00,0x00,0x5F,0x00,0x00}, // !
    {0x00,0x07,0x00,0x07,0x00}, // "
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    {0x08,0x04,0x08,0x10,0x08}, // ~
};

namespace Clock {

bool SSD1306::sendCommands(const uint8_t *cmds, size_t len) {
    if (cmds == nullptr || len == 0) return false;
    // Each transaction carries a 0x00 control byte (command stream) followed by
    // the command bytes. Chunked to keep the stack buffer small.
    uint8_t chunk[1 + 32];
    chunk[0] = 0x00; // control byte: command stream
    size_t off = 0;
    while (off < len) {
        size_t n = len - off;
        if (n > 32) n = 32;
        memcpy(&chunk[1], cmds + off, n);
        if (!bus_.writeBytes(addr_, chunk, 1 + n)) return false;
        off += n;
    }
    return true;
}

bool SSD1306::sendBuffer() {
    // Stream the 1024-byte framebuffer as 8 page transactions, each a 0x40
    // control byte (data stream) followed by 128 data bytes (one GDDRAM page).
    uint8_t chunk[1 + 128];
    chunk[0] = 0x40; // control byte: data stream
    for (int page = 0; page < 8; page++) {
        memcpy(&chunk[1], &buffer_[page * 128], 128);
        if (!bus_.writeBytes(addr_, chunk, sizeof(chunk))) return false;
    }
    return true;
}

bool SSD1306::init() {
    // SSD1306 Initialization Sequence
    static const uint8_t init_cmds[] = {
        0xAE,        // Display OFF
        0xD5, 0x80,  // Set display clock divide ratio/oscillator frequency
        0xA8, 0x3F,  // Set multiplex ratio (1/64 duty)
        0xD3, 0x00,  // Set display offset
        0x40,        // Set start line address
        0x8D, 0x14,  // Enable charge pump
        0x20, 0x00,  // Set memory addressing mode (Horizontal)
        0xA1,        // Set segment re-map (Horizontal flip)
        0xC8,        // Set COM output scan direction (Flip vertically)
        0xDA, 0x12,  // Set COM pins hardware configuration
        0x81, 0xCF,  // Set contrast control
        0xD9, 0xF1,  // Set pre-charge period
        0xDB, 0x40,  // Set VCOMH deselect level
        0xA4,        // Entire display ON from RAM
        0xA6,        // Set normal display (not inverted)
        0xAF,        // Display ON
    };
    
    // Send the whole init sequence in a few bulk command transactions
    if (!sendCommands(init_cmds, sizeof(init_cmds))) {
        return false;
    }

    clear();
    flush();
    return true;
}

void SSD1306::clear() {
    memset(buffer_, 0, sizeof(buffer_));
}

void SSD1306::setPixel(int x, int y, bool color) {
    if (x < 0 || x >= 128 || y < 0 || y >= 64) return;
    if (color) {
        buffer_[x + (y / 8) * 128] |= (1 << (y % 8));
    } else {
        buffer_[x + (y / 8) * 128] &= ~(1 << (y % 8));
    }
}

void SSD1306::drawChar(int x, int y, char c, bool invert) {
    if (c < 32 || c > 126) return;
    const uint8_t *glyph = font5x7[c - 32];
    for (int i = 0; i < 5; i++) {
        uint8_t row = glyph[i];
        for (int j = 0; j < 8; j++) {
            bool pixel = (row & (1 << j)) != 0;
            if (invert) pixel = !pixel;
            setPixel(x + i, y + j, pixel);
        }
    }
}

void SSD1306::drawString(int x, int y, const char *str, bool invert) {
    if (!str) return;
    int px = x;
    while (*str) {
        drawChar(px, y, *str++, invert);
        px += 6; // 5 width + 1 spacing
        if (px > 120) break; // avoid clipping
    }
}

void SSD1306::renderHeader(bool wifiConnected) {
    // Top header bar
    // Wi-Fi indicator placeholder
    drawString(0, 0, "ESP32 CLOCK", false);
    if (wifiConnected) {
        drawString(92, 0, "NTP[OK]", false);
    } else {
        drawString(92, 0, "NTP--", true);
    }
    // Horizontal separator line (simple)
    for (int x = 0; x < 128; x++) {
        setPixel(x, 9, true);
    }
}

void SSD1306::flush() {
    // Set the GDDRAM window in one bulk command transaction:
    //   column address 0..127, then page address 0..7
    static const uint8_t window_cmds[] = {
        0x21, 0x00, 0x7F, // set column address: start 0, end 127
        0x22, 0x00, 0x07, // set page address:   start 0, end 7
    };
    sendCommands(window_cmds, sizeof(window_cmds));

    // Stream the whole framebuffer in 8 page transfers (was 1024 single-byte writes)
    sendBuffer();
}

} // namespace Clock